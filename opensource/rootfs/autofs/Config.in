## opensource/rootfs/autofs/Config.in
```kconfig
config MAL_PACKAGE_AUTOFS
	bool "autofs"
	default n
	help
	  Utility for kernel-based automounter for Linux

	  ftp://ftp.kernel.org/pub/linux/daemons/autofs
```

## opensource/rootfs/bdb/Config.in
```kconfig
config MAL_PACKAGE_BDB
	bool "bdb"
	default n
	help
	  Berkeley DB (BDB) is a high-performance, embedded database library
	  http://www.oracle.com/database/berkeley-db.html
```

## opensource/rootfs/ctorrent/Config.in
```kconfig
config MAL_PACKAGE_CTORRENT
	bool "ctorrent"
	default n
	help
	  CTorrent is a BitTorrent client implemented in C++ to be
	  lightweight and quick. 

	  http://ctorrent.sourceforge.net/
	  http://www.rahul.net/dholmes/ctorrent/
```

## opensource/rootfs/linux-2.6/drivers/wixgpio/Kconfig
```kconfig
config WIX_GPIO
        tristate "SxM GPIO support"
        default y
        ---help---
          If you want to use the event queue under Linux, say Y. If not, say N.
          The msg device will receiver the msg from the kernel and send it to
          the file, "/proc/wixgpio".
```

## opensource/rootfs/linux-2.6/security/trustees/Kconfig
```kconfig
config SECURITY_TRUSTEES
	tristate "Trustees ACLS"
	depends on SECURITY
	help
	  Implements a system similar to Netware ACLS allowing
	  global configuration of recursive ACLs via a centralized
	  file.  ACLs can be added to an entire directory tree and
	  masked out on subdirectories.  Trustees allows complex
	  permissions to be enforced system-wide without needing to
	  touch every file or maintain thousands of ugly POSIX
	  ACLs. See http://trustees.aeruder.net for more
	  information on trustees and the associated user-space
	  tools.

	  If you are unsure how to answer this question, answer N.
```
